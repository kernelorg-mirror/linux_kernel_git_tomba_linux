// SPDX-License-Identifier: GPL-2.0-or-later OR MIT
/*
 * Copyright 2023 Toradex
 */

/dts-v1/;

#include "k3-am625-verdin.dtsi"
#include "k3-am625-verdin-nonwifi.dtsi"
#include "k3-am625-verdin-dahlia.dtsi"

/ {
	model = "Toradex Verdin AM62 on Dahlia Board";
	compatible = "toradex,verdin-am62-nonwifi-dahlia",
		     "toradex,verdin-am62-nonwifi",
		     "toradex,verdin-am62",
		     "ti,am625";
};

