## Documentation/devicetree/bindings/media/i2c/ti,ds90ub954-q1.txt
```
Texas Instruments DS90UB954-Q1 dual video deserializer
======================================================

The TI DS90UB954-Q1 is a MIPI CSI-2 video deserializer that forwards video
streams from up to two FPD-Link 3 connections to a MIPI CSI-2 output. It
also allows access to remote I2C and GPIO.

Required properties:

 - compatible: must be "ti,ds90ub954-q1"

 - reg: main I2C slave address; optionally aliases for RX port registers
   and remote serializers. The main address is mandatory and must be the
   first, others are optional and fall back to defaults if not
   specified. See "reg-names".

 - reset-gpios: chip reset GPIO, active low (connected to PDB pin of the chip)
 - i2c-alias-pool: list of I2C addresses that are known to be available on the
                   "local" (SoC-to-deser) I2C bus; they will be picked at
		   runtime and used as aliases to reach remove I2C chips
 - gpio-controller
 - #gpio-cells: must be 3: FPD-Link 3 RX port number, remote gpio number, flags

Optional properties:

 - reg-names: names of I2C address used to communicate with the chip, must
              match the "reg" values; mandatory if there are 2 or more
              addresses
    - "main": the main I2C address, used to access shared registers
    - "rxport0", "rxport1": I2C alias to access FPD-link RX port specific
      registers; must not be used by other slaves on the same bus
    - "ser0", "ser1": I2C alias to access the remote serializer connected
      on each FPD-link RX port; must not be used by other slaves on the
      same bus
 - interrupts: interrupt pin from the chip

Required subnodes:

 - ports: A ports node with one port child node per device input and output
          port, in accordance with the video interface bindings defined in
          Documentation/devicetree/bindings/media/video-interfaces.txt. The
          port nodes are numbered as follows:

          Port Description
          ------------------------------------
          0    Input from FPD-Link 3 RX port 0
          1    Input from FPD-Link 3 RX port 1
          2    CSI-2 output

          Each port must have a "remote-chip" subnode that defines the remote
	  chip (serializer) with at least a "compatible" property

 - i2c-atr: contains one child per RX port, each describes the I2C bus on
            the remote side

	    Required properties:
	    - #address-cells = <1>;
	    - #size-cells = <0>;

	    Subnodes: one per each FPD-link RX port, each having:

	    Required properties for "i2c-atr" child bus nodes:
	    - reg: The number of the port where the remove chip is connected
	    - #address-cells = <1>;
	    - #size-cells = <0>;

	    Optional properties for "i2c-atr" child bus nodes:
	    - Other properties specific to the remote hardware
	    - Child nodes conforming to i2c bus binding


Device node example
-------------------

&i2c0 {
	deser: deser@3d {
		compatible = "ti,ds90ub954-q1";
		reg-names = "main", "rxport0", "rxport1", "ser0", "ser1";
		reg       = <0x3d>,  <0x40>,    <0x41>,   <0x44>, <0x45>;
		clocks = <&clk_25M>;
		interrupt-parent = <&gic>;
		interrupts = <3 1 IRQ_TYPE_LEVEL_HIGH>;
		reset-gpios = <&gpio_ctl 4 GPIO_ACTIVE_LOW>;

		i2c-alias-pool = /bits/ 16 <0x4a 0x4b 0x4c 0x4d 0x4e 0x4f>;

		gpio-controller;
		#gpio-cells = <3>; /* rxport, remote gpio num, flags */

		ports {
			#address-cells = <1>;
			#size-cells = <0>;

			port@0 {
				reg = <0>;
				ds90ub954_fpd3_in0: endpoint {
					remote-endpoint = <&sensor_0_out>;
				};
			};

			port@1 {
				reg = <1>;
				ds90ub954_fpd3_in1: endpoint {
					remote-endpoint = <&sensor_1_out>;
				};
			};

			port@2 {
				reg = <2>;
				ds90ub954_mipi_out0: endpoint {
					data-lanes = <1 2 3 4>;
					/* Actually a REFCLK multiplier */
					data-rate = <1600000000>;
					remote-endpoint = <&csirx_0_in>;
				};
			};
		};

		i2c-atr {
			#address-cells = <1>;
			#size-cells = <0>;

			remote_i2c0: i2c@0 {
				reg = <0>;
				#address-cells = <1>;
				#size-cells = <0>;
			};

			remote_i2c1: i2c@1 {
				reg = <1>;
				#address-cells = <1>;
				#size-cells = <0>;
			};
		};
	};
};

&ds90ub954_fpd3_in0 {
	remote-chip {
		compatible = "ti,ds90ub953-q1";
		gpio-functions = <DS90_GPIO_FUNC_OUTPUT_REMOTE
				  DS90_GPIO_FUNC_UNUSED
				  DS90_GPIO_FUNC_UNUSED
				  DS90_GPIO_FUNC_UNUSED>;
	};
};

&ds90ub954_fpd3_in1 {
	remote-chip {
		compatible = "ti,ds90ub953-q1";
		gpio-functions = <DS90_GPIO_FUNC_OUTPUT_REMOTE
				  DS90_GPIO_FUNC_UNUSED
				  DS90_GPIO_FUNC_UNUSED
				  DS90_GPIO_FUNC_UNUSED>;
	};
};

&remote_i2c0 {
	sensor_0@3c {
		compatible = "sony,imx274";
		reg = <0x3c>;

		reset-gpios = <&deser 0 0 GPIO_ACTIVE_LOW>;

		#address-cells = <1>;
		#size-cells = <0>;

		port@0 {
			reg = <0>;
			sensor_0_out: endpoint {
				remote-endpoint = <&ds90ub954_fpd3_in0>;
			};
		};
	};
};

&remote_i2c1 {
	sensor_0@3c {
		compatible = "sony,imx274";
		reg = <0x3c>;

		reset-gpios = <&deser 1 0 GPIO_ACTIVE_LOW>;

		#address-cells = <1>;
		#size-cells = <0>;

		port@0 {
			reg = <0>;
			sensor_1_out: endpoint {
				remote-endpoint = <&ds90ub954_fpd3_in1>;
			};
		};
	};
};
```

## Documentation/devicetree/bindings/media/raspberrypi,rp1-cfe.yaml
```yaml
# SPDX-License-Identifier: (GPL-2.0+ OR MIT)
%YAML 1.2
---
$id: http://devicetree.org/schemas/media/raspberrypi,rp1-cfe.yaml#
$schema: http://devicetree.org/meta-schemas/core.yaml#

title: Raspberry Pi PiSP Camera Front End

maintainers:
  - Dave Stevenson <dave.stevenson@raspberrypi.com>
  - David Plowman <david.plowman@raspberrypi.com>
  - Naushir Patuck <naush@raspberrypi.com>
  - Nick Hollinghurst <nick.hollinghurst@raspberrypi.com>
  - Tomi Valkeinen <tomi.valkeinen@ideasonboard.com>

description: |
  The Raspberry Pi PiSP Camera Front End is a MIPI CSI-2 receiver with a simple
  image processor.

  The full ISP documentation is available at:
  https://datasheets.raspberrypi.com/camera/raspberry-pi-image-signal-processor-specification.pdf

  The CSI-2 receiver part has no public documentation.

properties:
  compatible:
    const: raspberrypi,rp1-cfe

  reg:
    items:
      - description: CSI-22
      - description: D-PHY
      - description: MIPI CFG
      - description: FE

  interrupts:
    maxItems: 1

  clocks:
    maxItems: 1

  port:
    $ref: /schemas/graph.yaml#/$defs/port-base
    additionalProperties: false

    properties:
      endpoint:
        $ref: video-interfaces.yaml#
        unevaluatedProperties: false

        properties:
          data-lanes:
            minItems: 1
            maxItems: 4

          clock-lanes:
            maxItems: 1

          clock-noncontinuous: true

           # XXX what is this: multipacket-line

        required:
          - clock-lanes
          - data-lanes

required:
  - compatible
  - reg
  - interrupts
  - clocks

additionalProperties: false

examples:
  - |
    #include <dt-bindings/mfd/rp1.h>
    #include <dt-bindings/interrupt-controller/irq.h>
    #include <dt-bindings/clock/rp1.h>

    rpi1 {
        #address-cells = <2>;
        #size-cells = <2>;

      csi@110000 {
        compatible = "raspberrypi,rp1-cfe";
        reg = <0xc0 0x40110000  0x0 0x100>,
              <0xc0 0x40114000  0x0 0x100>,
              <0xc0 0x40120000  0x0 0x100>,
              <0xc0 0x40124000  0x0 0x1000>;

        interrupts = <RP1_INT_MIPI0 IRQ_TYPE_LEVEL_HIGH>;

        clocks = <&rp1_clocks RP1_CLK_MIPI0_CFG>;

        port {
          csi_ep: endpoint {
            remote-endpoint = <&cam_endpoint>;
            clock-lanes = <0>;
            data-lanes = <1 2>;
          };
        };
      };
    };
```
