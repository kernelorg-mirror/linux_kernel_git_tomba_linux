// SPDX-License-Identifier: GPL-2.0-or-later OR MIT
/*
 * Copyright 2023 Toradex
 */

/dts-v1/;

#include "k3-am625-verdin.dtsi"
#include "k3-am625-verdin-wifi.dtsi"
#include "k3-am625-verdin-dahlia.dtsi"

/ {
	model = "Toradex Verdin AM62 WB on Dahlia Board";
	compatible = "toradex,verdin-am62-wifi-dahlia",
		     "toradex,verdin-am62-wifi",
		     "toradex,verdin-am62",
		     "ti,am625";
};
