## Documentation/devicetree/bindings/dma/xilinx/xlnx,v-frmbuf.yaml
```yaml
# SPDX-License-Identifier: (GPL-2.0-only OR BSD-2-Clause)
%YAML 1.2
---
$id: http://devicetree.org/schemas/dma/xilinx/xlnx,axi-frmbuf.yaml#
$schema: http://devicetree.org/meta-schemas/core.yaml#

title: Xilinx AXI Framebuffer DMA Controller

maintainers:
  - Tomi Valkeinen <tomi.valkeinen@ideasonboard.com>

description: |
  The Xilinx framebuffer DMA engine supports two soft IP blocks: one IP
  block is used for reading video frame data from memory (FB Read) to the
  device and the other IP block is used for writing video frame data from
  the device to memory (FB Write). Both the FB Read/Write IP blocks are
  aware of the format of the data being written to or read from memory
  including RGB and YUV in packed, planar, and semi-planar formats.

  Video Format Mapping:
  The xlnx,vid-formats property uses string values corresponding to the
  hardware format IDs. The table below lists the supported formats. See
  Xilinx's "Video Frame Buffer Read and Video Frame Buffer Write LogiCORE IP
  Product Guide (PG278 (v3.0) May 29, 2025)" for descriptions of the formats.

  IP Format    BPC  Format ID  DTS String      Notes
  -----------  ---  ---------  --------------  ----------------------------------
  Y8           8    24         y8
  RGB8         8    20         bgr888
  BGR8         8    29         rgb888
  YUV8         8    21         vuy888
  RGBX8        8    10         xbgr8888
  BGRX8        8    27         xrgb8888
  YUVX8        8    11         xvuy8888
  YUYV8        8    12         yuyv
  UYVY8        8    28         uyvy
  RGBA8        8    13         abgr8888        FB Read only
  BGRA8        8    26         argb8888        FB Read only
  YUVA8        8    14         avuy8888        FB Read only
  Y_UV8        8    18         nv16
  Y_UV8_420    8    19         nv12
  Y_U_V8       8    42         y_u_v8
  Y_U_V8_420   8    41         TBD
  XY10         10   25         y10
  Y_UV10       10   22         xv20
  Y_UV10_420   10   23         xv15
  RGBX10       10   15         xbgr2101010
  YUVX10       10   16         yuvx2101010
  Y_U_V10      10   43         TBD
  Y12          12   34         TBD
  Y_UV12       12   32         TBD
  Y_UV12_420   12   33         TBD
  RGBX12       12   30         xbgr2121212
  YUVX12       12   31         TBD
  Y_U_V12      12   44         TBD
  Y16          16   39         TBD
  Y_UV16       16   37         TBD
  Y_UV16_420   16   38         TBD
  RGB16        16   35         rgb16
  YUV16        16   36         TBD

allOf:
  - $ref: ../dma-controller.yaml#

properties:
  compatible:
    enum:
      - xlnx,v-frmbuf-rd-3.0
      - xlnx,v-frmbuf-wr-3.0

  "#dma-cells":
    const: 1

  reg:
    maxItems: 1

  interrupts:
    maxItems: 1

  clocks:
    maxItems: 1
    description: AXI Streaming clock feeding the AP_CLK

  clock-names:
    items:
      - const: ap_clk

  reset-gpios:
    maxItems: 1
    description: GPIO reset phandle

  xlnx,dma-addr-width:
    $ref: /schemas/types.yaml#/definitions/uint32
    enum: [32, 64]
    description: Size of DMA address pointer in IP (either 32 or 64 bits)

  xlnx,vid-formats:
    $ref: /schemas/types.yaml#/definitions/string-array
    description:
      List of strings indicating what video memory formats the IP has been
      configured to support. See the video format mapping table above.

  xlnx,pixels-per-clock:
    $ref: /schemas/types.yaml#/definitions/uint32
    enum: [1, 2, 4, 8]
    description: Pixels per clock configured in the IP

  xlnx,max-height:
    $ref: /schemas/types.yaml#/definitions/uint32
    minimum: 64
    maximum: 8640
    description: Maximum number of lines

  xlnx,max-width:
    $ref: /schemas/types.yaml#/definitions/uint32
    minimum: 64
    maximum: 15360
    description: Maximum number of pixels in a line

  xlnx,dma-align:
    $ref: /schemas/types.yaml#/definitions/uint32
    description:
      DMA alignment required in bytes. Must be a power of 2 and at least
      pixels-per-clock * 8. If absent, DMA alignment is calculated as
      pixels-per-clock * 8. Minimum is 8, 16, or 32 when pixels-per-clock
      is 1, 2, or 4 respectively.

  xlnx,fid:
    type: boolean
    description:
      Field ID enabled for interlaced video support. Can be absent for
      progressive video.

required:
  - compatible
  - "#dma-cells"
  - reg
  - interrupts
  - clocks
  - clock-names
  - xlnx,dma-addr-width
  - xlnx,vid-formats
  - xlnx,pixels-per-clock
  - xlnx,max-height
  - xlnx,max-width

additionalProperties: false

examples:
  - |
    #include <dt-bindings/gpio/gpio.h>

    v_frmbuf_rd_0: dma-controller@80000000 {
        #dma-cells = <1>;
        compatible = "xlnx,axi-frmbuf-rd-v2.1";
        clocks = <&vid_stream_clk>;
        clock-names = "ap_clk";
        interrupt-parent = <&gic>;
        interrupts = <0 92 4>;
        reset-gpios = <&gpio 80 GPIO_ACTIVE_HIGH>;
        reg = <0x80000000 0x10000>;
        xlnx,dma-addr-width = <32>;
        xlnx,vid-formats = "bgr888", "xbgr8888";
        xlnx,pixels-per-clock = <1>;
        xlnx,dma-align = <8>;
        xlnx,max-width = <3840>;
        xlnx,max-height = <2160>;
    };

  - |
    #include <dt-bindings/gpio/gpio.h>

    v_frmbuf_wr_0: dma-controller@80010000 {
        #dma-cells = <1>;
        compatible = "xlnx,axi-frmbuf-wr-v2.1";
        clocks = <&vid_stream_clk>;
        clock-names = "ap_clk";
        interrupt-parent = <&gic>;
        interrupts = <0 93 4>;
        reset-gpios = <&gpio 80 GPIO_ACTIVE_HIGH>;
        reg = <0x80010000 0x10000>;
        xlnx,dma-addr-width = <64>;
        xlnx,vid-formats = "bgr888", "yuyv", "nv16", "nv12";
        xlnx,pixels-per-clock = <2>;
        xlnx,dma-align = <16>;
        xlnx,max-width = <3840>;
        xlnx,max-height = <2160>;
    };
```

## Documentation/devicetree/bindings/i2c/i2c-atr.yaml
```yaml
# SPDX-License-Identifier: GPL-2.0
%YAML 1.2
---
$id: http://devicetree.org/schemas/i2c/i2c-atr.yaml#
$schema: http://devicetree.org/meta-schemas/core.yaml#

title: i2c bus address translator properties.

maintainers:
  - Tomi Valkeinen <tomi.valkeinen@ideasonboard.com>

description: |+
  An i2c bus address translator will have several child busses that are numbered
  uniquely in a device dependent manner.  The nodes for an i2c bus
  address translator will have one child node for each child bus.

properties:
  $nodename:
    pattern: '^i2c-atr'

  '#address-cells':
    const: 1

  '#size-cells':
    const: 0

patternProperties:
  '^i2c@[0-9a-f]+$':
    $ref: /schemas/i2c/i2c-controller.yaml
    unevaluatedProperties: false

    properties:
      reg:
        description: The atr selector sub-bus number for the child I2C bus.
        maxItems: 1

additionalProperties: true

examples:
  - |
    deser@3d {
      compatible = "ti,ds90ub960-q1";

      i2c-atr {
          #address-cells = <1>;
          #size-cells = <0>;

          i2c@0 {
              #address-cells = <1>;
              #size-cells = <0>;
              reg = <0>;

              sensor@21 {
                  compatible = "sony,imx390";
                  reg = <0x21>;
              };
          };
      };
    };
...
```

## Documentation/devicetree/bindings/media/i2c/ti,ds90ub913.yaml
```yaml
# SPDX-License-Identifier: (GPL-2.0-only OR BSD-2-Clause)
%YAML 1.2
---
$id: http://devicetree.org/schemas/media/i2c/ti,ds90ub913.yaml#
$schema: http://devicetree.org/meta-schemas/core.yaml#

title: Texas Instruments DS90UB913 FPD-Link 3 Serializer

maintainers:
  - Tomi Valkeinen <tomi.valkeinen@ideasonboard.com>

description:
  The TI DS90UB913 is an FPD-Link 3 video serializer for parallel video.

properties:
  compatible:
    enum:
      - ti,ds90ub913a-q1

  '#gpio-cells':
    const: 2

  gpio-controller: true

  clocks:
    maxItems: 1
    description:
      Reference clock connected to the CLKIN pin.

  clock-names:
    items:
      - const: clkin

  '#clock-cells':
    const: 0

  ports:
    $ref: /schemas/graph.yaml#/properties/ports

    properties:
      port@0:
        $ref: /schemas/graph.yaml#/$defs/port-base
        unevaluatedProperties: false
        description: CSI-2 input port

        properties:
          endpoint:
            $ref: /schemas/media/video-interfaces.yaml#
            unevaluatedProperties: false

      port@1:
        $ref: /schemas/graph.yaml#/properties/port
        unevaluatedProperties: false
        description: FPD-Link 3 output port

  i2c:
    $ref: /schemas/i2c/i2c-controller.yaml#
    unevaluatedProperties: false

required:
  - compatible
  - '#gpio-cells'
  - gpio-controller
  - '#clock-cells'
  - ports

additionalProperties: false

examples:
  - |
    #include <dt-bindings/gpio/gpio.h>

    serializer {
      compatible = "ti,ds90ub913a-q1";

      gpio-controller;
      #gpio-cells = <2>;

      clocks = <&clk_cam_48M>;
      clock-names = "clkin";

      #clock-cells = <0>;

      ports {
        #address-cells = <1>;
        #size-cells = <0>;

        port@0 {
          reg = <0>;
          ub913_in: endpoint {
            remote-endpoint = <&sensor_out>;
          };
        };

        port@1 {
          reg = <1>;
          endpoint {
            remote-endpoint = <&deser_fpd_in>;
          };
        };
      };

      i2c {
        #address-cells = <1>;
        #size-cells = <0>;

        sensor@48 {
          compatible = "aptina,mt9v111";
          reg = <0x48>;

          clocks = <&fixed_clock>;

          port {
            sensor_out: endpoint {
              remote-endpoint = <&ub913_in>;
            };
          };
        };
      };
    };
...
```

## Documentation/devicetree/bindings/media/i2c/ti,ds90ub953-q1.txt
```
Texas Instruments DS90UB953-Q1 video serializer
===============================================

The TI DS90UB953-Q1 is a MIPI CSI-2 video serializer that forwards a MIPI
CSI-2 input video stream over an FPD Link 3 connection to a remote
deserializer. It also allows access to I2C and GPIO from the deserializer.

The DT definitions can be found in include/dt-bindings/media/ds90ub953.h

When used as a the remote counterpart of a deserializer (e.g. the
DS90UB954-Q1), the serializer is described in the
"deserializer/ports/port@<N>/endpoint/remote-chip" node.

Required properties:

 - compatible: must be "ti,ds90ub953-q1"

Optional properties:

 - gpio-functions: a list of 4 values defining how the 4 GPIO pins are
   connected in hardware; possible values are:
    - DS90_GPIO_FUNC_UNUSED (0): the GPIO is not connected
    - DS90_GPIO_FUNC_INPUT (1): the GPIO is an input to the ds90ub953
    - DS90_GPIO_FUNC_OUTPUT_REMOTE (2): the GPIO is an output from the
      ds90ub953, to be driven from the remote chip (deserializer)

 - ti,ds90ub953-q1-clk-inv-pol-quirk: the MIPI CSI-2 input clock lane has
                                      inverted polarity


Device node example
-------------------

&ds90ub954_fpd3_in0 {
	remote-chip {
		compatible = "ti,ds90ub953-q1";
		gpio-functions = <DS90_GPIO_FUNC_OUTPUT_REMOTE
				  DS90_GPIO_FUNC_OUTPUT_REMOTE
				  DS90_GPIO_FUNC_UNUSED
				  DS90_GPIO_FUNC_UNUSED>;
	};
};
```

## Documentation/devicetree/bindings/media/i2c/ti,ds90ub953.yaml
```yaml
# SPDX-License-Identifier: (GPL-2.0-only OR BSD-2-Clause)
%YAML 1.2
---
$id: http://devicetree.org/schemas/media/i2c/ti,ds90ub953.yaml#
$schema: http://devicetree.org/meta-schemas/core.yaml#

title: Texas Instruments DS90UB953 FPD-Link 3 Serializer

maintainers:
  - Tomi Valkeinen <tomi.valkeinen@ideasonboard.com>

description:
  The TI DS90UB953 is an FPD-Link 3 video serializer for MIPI CSI-2.

properties:
  compatible:
    enum:
      - ti,ds90ub953-q1
      - ti,ds90ub971-q1

  '#gpio-cells':
    const: 2

  gpio-controller: true

  '#clock-cells':
    const: 0

  ports:
    $ref: /schemas/graph.yaml#/properties/ports

    properties:
      port@0:
        $ref: /schemas/graph.yaml#/$defs/port-base
        unevaluatedProperties: false
        description: CSI-2 input port

        properties:
          endpoint:
            $ref: /schemas/media/video-interfaces.yaml#
            unevaluatedProperties: false

      port@1:
        $ref: /schemas/graph.yaml#/properties/port
        unevaluatedProperties: false
        description: FPD-Link 3 output port

  i2c:
    $ref: /schemas/i2c/i2c-controller.yaml#
    unevaluatedProperties: false

required:
  - compatible
  - '#gpio-cells'
  - gpio-controller
  - '#clock-cells'
  - ports

additionalProperties: false

examples:
  - |
    #include <dt-bindings/gpio/gpio.h>

    serializer {
      compatible = "ti,ds90ub953-q1";

      gpio-controller;
      #gpio-cells = <2>;

      #clock-cells = <0>;

      ports {
        #address-cells = <1>;
        #size-cells = <0>;

        port@0 {
          reg = <0>;
          ub953_in: endpoint {
            clock-lanes = <0>;
            data-lanes = <1 2 3 4>;
            remote-endpoint = <&sensor_out>;
          };
        };

        port@1 {
          reg = <1>;
          endpoint {
            remote-endpoint = <&deser_fpd_in>;
          };
        };
      };

      i2c {
        #address-cells = <1>;
        #size-cells = <0>;

        sensor@1a {
          compatible = "sony,imx274";
          reg = <0x1a>;

          reset-gpios = <&serializer 0 GPIO_ACTIVE_LOW>;

          port {
            sensor_out: endpoint {
              remote-endpoint = <&ub953_in>;
            };
          };
        };
      };
    };
...
```
